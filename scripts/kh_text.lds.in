/* KernelHook: isolate library code into page-aligned section.
 * Generated by CMake — do not edit directly.
 * Page alignment: @KH_PAGE_ALIGN@ bytes */
SECTIONS {
    .text.kh ALIGN(@KH_PAGE_ALIGN@) : {
        __kh_text_start = .;
        /* Match library .o members inside the static archive.
         * lld requires archive(member) syntax for .a members. */
        /* transit.c.o is excluded: its transit_body functions use PC-relative
         * references to .transit.data and are copied to ROX pages at runtime,
         * so they don't need page isolation and must stay near .transit.data. */
        *libkernelhook.a:core_user.c.o(.text .text.*)
        *libkernelhook.a:hmem.c.o(.text .text.*)
        *libkernelhook.a:inline.c.o(.text .text.*)
        *libkernelhook.a:insn.c.o(.text .text.*)
        *libkernelhook.a:linux.c.o(.text .text.*)
        *libkernelhook.a:darwin.c.o(.text .text.*)
        *libkernelhook.a:hook_mem_user.c.o(.text .text.*)
        *libkernelhook.a:hook_install_user.c.o(.text .text.*)
        *libkernelhook.a:log_user.c.o(.text .text.*)
        *libkernelhook.a:remote_linux.c.o(.text .text.*)
        *libkernelhook.a:remote_stub.c.o(.text .text.*)
        *libkernelhook.a:kh_section_fence.c.o(.text .text.*)
        . = ALIGN(@KH_PAGE_ALIGN@);
        __kh_text_end = .;
    }
}
INSERT AFTER .text;
